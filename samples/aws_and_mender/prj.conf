## CMakeLists.txt
```
# Copyright (c) 2026 ID8 Engineering AB
# SPDX-License-Identifier: Apache-2.0

cmake_minimum_required(VERSION 3.13.1)
find_package(Zephyr REQUIRED HINTS $ENV{ZEPHYR_BASE})

project(app LANGUAGES C)

target_sources(app PRIVATE
  src/main.c
  ${ZEPHYR_BASE}/modules/mbedtls/zephyr_entropy.c # Mender client needs legacy crypto mbedTLS
)

# Must be compiled with the right CONFIG option to enable mbedtls_hardware_poll()
set_source_files_properties(
  ${ZEPHYR_BASE}/modules/mbedtls/zephyr_entropy.c
  PROPERTIES
  COMPILE_DEFINITIONS CONFIG_MBEDTLS_ENTROPY_POLL_ZEPHYR=1
)
```

## prj.conf
```kconfig
# Logging
CONFIG_LOG_OUTPUT_FORMAT_ISO8601_TIMESTAMP=y
CONFIG_POSIX_C_LANG_SUPPORT_R=y
CONFIG_LOG=y
CONFIG_LOG_DEFAULT_LEVEL=2
CONFIG_LOG_BUFFER_SIZE=2048
CONFIG_HW_STACK_PROTECTION=y

# AWS
# Set at build time:
# CONFIG_AWS_IOT_BROKER_HOST_NAME="your-aws-endpoint.amazonaws.com"
# CONFIG_AWS_IOT_CLIENT_ID_STATIC="your-aws-thing-name"
# CONFIG_MQTT_HELPER_SEC_TAG=123
CONFIG_AWS_IOT=y
CONFIG_ASSERT=y
CONFIG_REBOOT=y

# IP / DHCP
CONFIG_NETWORKING=y
CONFIG_NET_NATIVE=y
CONFIG_NET_IPV6=n
CONFIG_NET_IPV4=y
CONFIG_NET_DHCPV4=y
CONFIG_NET_CONNECTION_MANAGER=y
CONFIG_NET_CONNECTION_MANAGER_MONITOR_STACK_SIZE=1024
CONFIG_NRF_MODEM_LIB_NET_IF=y

# Network event notifications
CONFIG_NET_MGMT=y
CONFIG_NET_MGMT_EVENT=y
CONFIG_NET_MGMT_EVENT_STACK_SIZE=2048

# Enable TLS
CONFIG_NET_SOCKETS_SOCKOPT_TLS=y
CONFIG_NET_SOCKETS_TLS_MAX_CONTEXTS=2
CONFIG_NET_MAX_CONN=4
CONFIG_MBEDTLS_USER_CONFIG_ENABLE=y
CONFIG_MBEDTLS_USER_CONFIG_FILE="config-tls-mender.h"


# DNS configuration
CONFIG_DNS_RESOLVER_ADDITIONAL_BUF_CTR=5
CONFIG_DNS_RESOLVER_ADDITIONAL_QUERIES=2
CONFIG_DNS_RESOLVER_MAX_SERVERS=2
CONFIG_DNS_NUM_CONCUR_QUERIES=5

# Avoid timeouts before receiving SYN-ACK from peer at default value (3000)
CONFIG_NET_SOCKETS_CONNECT_TIMEOUT=5000

# Memory
CONFIG_HEAP_MEM_POOL_SIZE=12288
CONFIG_MAIN_STACK_SIZE=4096
CONFIG_SYSTEM_WORKQUEUE_STACK_SIZE=6144
CONFIG_ZVFS_OPEN_MAX=5

# Modem
CONFIG_NRF_MODEM_LIB=y
CONFIG_LTE_LINK_CONTROL=y
CONFIG_MODEM_KEY_MGMT=y

# Security backend
CONFIG_NORDIC_SECURITY_BACKEND=y
CONFIG_BUILD_WITH_TFM=y
#CONFIG_ENTROPY_CC3XX=y

#Mender
# Set at build time:
# CONFIG_MENDER_SERVER_TENANT_TOKEN="your-mender-tenant-token"
CONFIG_MENDER_ARTIFACT_DOWNLOAD_RANGES=y
CONFIG_MENDER_MCU_CLIENT=y
CONFIG_MENDER_SERVER_HOST_EU=y
CONFIG_MENDER_PLATFORM_NET_TYPE_DEFAULT=y
CONFIG_MENDER_DEVICE_TYPE="seven_nrf9151"
CONFIG_MENDER_LOG_LEVEL_INF=y
CONFIG_MENDER_DEPLOYMENT_LOGS=y
CONFIG_MENDER_ARTIFACT_GENERATE=y
CONFIG_MENDER_ARTIFACT_NAME="V0.1"
CONFIG_MENDER_HEAP_SIZE=16
CONFIG_MENDER_STORAGE_PARTITION_STORAGE_PARTITION=y
CONFIG_MENDER_STORAGE_NVS_SECTOR_COUNT=4
CONFIG_MENDER_SERVER_DORMANT_CERTIFICATES=n
CONFIG_MENDER_NET_CA_CERTIFICATE_TAG_SECONDARY_ENABLED=y
CONFIG_MENDER_FULL_PARSE_ARTIFACT=y
CONFIG_MENDER_CLIENT_INVENTORY_NETWORK_INFO=n # See, https://github.com/id8-engineering/nrf9151-dk-mender/issues/18
CONFIG_MENDER_PROVIDES_DEPENDS=y
CONFIG_MENDER_COMMIT_REQUIRE_AUTH=y
CONFIG_CJSON_LIB=y
CONFIG_PICOLIBC_IO_FLOAT=y

CONFIG_MBEDTLS=y
CONFIG_MBEDTLS_USE_PSA_CRYPTO=n
CONFIG_MBEDTLS_KEY_EXCHANGE_ECDHE_ECDSA_ENABLED=y
# Enable AES cipher (required for GCM cipher suites)
CONFIG_MBEDTLS_ECDH_C=y
CONFIG_MBEDTLS_ECDSA_C=y
CONFIG_MBEDTLS_ECP_C=y
# PSA crypto support (required when MBEDTLS_USE_PSA_CRYPTO is enabled)
CONFIG_PSA_WANT_ALG_ECDH=y
CONFIG_PSA_WANT_ALG_ECDSA=y
CONFIG_PSA_WANT_KEY_TYPE_ECC_PUBLIC_KEY=y
CONFIG_PSA_WANT_KEY_TYPE_ECC_KEY_PAIR_IMPORT=y
CONFIG_PSA_WANT_KEY_TYPE_ECC_KEY_PAIR_GENERATE=y
# Enable GCM support via PSA crypto
CONFIG_PSA_WANT_ALG_GCM=y
CONFIG_PSA_WANT_KEY_TYPE_AES=y
CONFIG_MBEDTLS_GENPRIME_ENABLED=y
CONFIG_MBEDTLS_PK_WRITE_C=y
CONFIG_MBEDTLS_ENABLE_HEAP=y
CONFIG_MBEDTLS_HEAP_SIZE=32768
CONFIG_MBEDTLS_ENTROPY_C=y


CONFIG_MBEDTLS_TLS_LIBRARY=y
CONFIG_MBEDTLS_X509_LIBRARY=y
CONFIG_MBEDTLS_MD_C=y
CONFIG_MBEDTLS_PK_C=y
CONFIG_MBEDTLS_PK_PARSE_C=y
CONFIG_MBEDTLS_PEM_WRITE_C=y
CONFIG_MBEDTLS_CTR_DRBG_ENABLED=y
CONFIG_MBEDTLS_CTR_DRBG_C=y
CONFIG_MBEDTLS_SHA256_C=y
CONFIG_MBEDTLS_SSL_IN_CONTENT_LEN=4096
# force off problematic families for TF-M
CONFIG_MBEDTLS_KEY_EXCHANGE_ECDHE_PSK_ENABLED=n
CONFIG_MBEDTLS_KEY_EXCHANGE_ECDHE_RSA_ENABLED=n
CONFIG_MBEDTLS_KEY_EXCHANGE_DHE_PSK_ENABLED=n
CONFIG_MBEDTLS_KEY_EXCHANGE_DHE_RSA_ENABLED=n
CONFIG_MBEDTLS_SSL_CONTEXT_SERIALIZATION=n

# nrf
CONFIG_SOC_FLASH_NRF_EMULATE_ONE_BYTE_WRITE_ACCESS=y

# MQTT / AWS helper
CONFIG_MQTT_HELPER=y
CONFIG_MQTT_HELPER_LAST_WILL=y
CONFIG_MQTT_HELPER_STACK_SIZE=4096
CONFIG_MQTT_KEEPALIVE=1200
CONFIG_MQTT_CLEAN_SESSION=y

# Bootloader / FOTA
CONFIG_BOOTLOADER_MCUBOOT=y
CONFIG_MCUBOOT_IMG_MANAGER=y
CONFIG_IMG_MANAGER=y
CONFIG_STREAM_FLASH=y
CONFIG_FLASH_MAP=y
CONFIG_FLASH=y
CONFIG_IMG_ERASE_PROGRESSIVELY=y
```

## src/main.c
```c
// Copyright (c) 2026 ID8 Engineering AB
// SPDX-License-Identifier: Apache-2.0
// This sample is largly based on
// https://github.com/nrfconnect/sdk-nrf/tree/main/samples/net/aws_iot

#include <errno.h>
#include <stdio.h>
#include <string.h>

#include <zephyr/kernel.h>
#include <zephyr/logging/log.h>
#include <zephyr/sys/reboot.h>

#include <net/aws_iot.h>

#include <modem/lte_lc.h>
#include <modem/nrf_modem_lib.h>

#include <mender/client.h>
#include <mender/zephyr-image-update-module.h>
#include <cJSON.h>

LOG_MODULE_REGISTER(main, LOG_LEVEL_INF);

static void aws_publish_work_fn(struct k_work *work);
static void aws_connect_work_fn(struct k_work *work);
static void aws_iot_event_handler(const struct aws_iot_evt *const evt);

static K_WORK_DELAYABLE_DEFINE(aws_publish_work, aws_publish_work_fn);
static K_WORK_DELAYABLE_DEFINE(aws_connect_work, aws_connect_work_fn);

#define AWS_TOPIC_INPUT              CONFIG_AWS_IOT_CLIENT_ID_STATIC "/input"
#define AWS_TOPIC_OUTPUT             CONFIG_AWS_IOT_CLIENT_ID_STATIC "/output"
#define AWS_PUBLISH_INTERVAL_SECONDS 10
#define AWS_CONNECTION_RETRY_SECONDS 5
#define MENDER_POLL_INTERVAL_SECONDS 60

static mender_identity_t mender_identity = {
	.name = "device_id",
	.value = CONFIG_MENDER_DEVICE_TYPE,
};

static bool aws_connected;

static int aws_app_topics_subscribe(void)
{
	static const struct mqtt_topic topic_list[] = {
		{
			.topic =
				{
					.utf8 = AWS_TOPIC_INPUT,
					.size = sizeof(AWS_TOPIC_INPUT) - 1,
				},
			.qos = MQTT_QOS_1_AT_LEAST_ONCE,
		},
	};

	return aws_iot_application_topics_set(topic_list, ARRAY_SIZE(topic_list));
}

static int aws_client_init(void)
{
	int err;

	err = aws_iot_init(aws_iot_event_handler);
	if (err) {
		return err;
	}

	return aws_app_topics_subscribe();
}

static void aws_publish_message(void)
{
	cJSON *json;
	char message[sizeof("Hello from !") + sizeof(CONFIG_AWS_IOT_CLIENT_ID_STATIC)];
	char payload[256];
	struct aws_iot_data tx_data = {
		.qos = MQTT_QOS_0_AT_MOST_ONCE,
		.topic =
			{
				.str = AWS_TOPIC_OUTPUT,
				.len = sizeof(AWS_TOPIC_OUTPUT) - 1,
			},
	};
	int err;

	json = cJSON_CreateObject();
	if (json == NULL) {
		LOG_ERR("Unable to create AWS JSON payload");
		return;
	}

	snprintk(message, sizeof(message), "Hello from %s!", CONFIG_AWS_IOT_CLIENT_ID_STATIC);

	if (cJSON_AddStringToObject(json, "message", message) == NULL) {
		LOG_ERR("Unable to add AWS message to payload");
		cJSON_Delete(json);
		return;
	}

	if (!cJSON_PrintPreallocated(json, payload, sizeof(payload), false)) {
		LOG_ERR("Unable to format AWS JSON payload");
		cJSON_Delete(json);
		return;
	}

	tx_data.ptr = payload;
	tx_data.len = strlen(payload);

	err = aws_iot_send(&tx_data);
	cJSON_Delete(json);

	if (err) {
		LOG_ERR("AWS publish failed: %d", err);
		return;
	}

	LOG_INF("Published \"%s\" to \"%s\"", payload, AWS_TOPIC_OUTPUT);
}

static void aws_publish_work_fn(struct k_work *work)
{
	ARG_UNUSED(work);

	if (!aws_connected) {
		return;
	}

	aws_publish_message();

	(void)k_work_reschedule(&aws_publish_work, K_SECONDS(AWS_PUBLISH_INTERVAL_SECONDS));
}

static void aws_connect_work_fn(struct k_work *work)
{
	int err;

	ARG_UNUSED(work);

	LOG_INF("Connecting to AWS IoT");

	err = aws_iot_connect(NULL);
	if (err == -EAGAIN) {
		(void)k_work_reschedule(&aws_connect_work, K_SECONDS(AWS_CONNECTION_RETRY_SECONDS));
		return;
	}

	if (err) {
		LOG_ERR("AWS connect failed: %d", err);
		(void)k_work_reschedule(&aws_connect_work, K_SECONDS(AWS_CONNECTION_RETRY_SECONDS));
	}
}

static void aws_on_connected(const struct aws_iot_evt *const evt)
{
	aws_connected = true;
	(void)k_work_cancel_delayable(&aws_connect_work);

	if (evt->data.persistent_session) {
		LOG_WRN("AWS persistent session is enabled");
	}

	(void)k_work_reschedule(&aws_publish_work, K_NO_WAIT);
}

static void aws_on_disconnected(void)
{
	aws_connected = false;
	(void)k_work_cancel_delayable(&aws_publish_work);
	(void)k_work_reschedule(&aws_connect_work, K_SECONDS(AWS_CONNECTION_RETRY_SECONDS));
}

static void aws_iot_event_handler(const struct aws_iot_evt *const evt)
{
	switch (evt->type) {
	case AWS_IOT_EVT_CONNECTING:
		LOG_INF("AWS_IOT_EVT_CONNECTING");
		break;
	case AWS_IOT_EVT_CONNECTED:
		LOG_INF("AWS_IOT_EVT_CONNECTED");
		aws_on_connected(evt);
		break;
	case AWS_IOT_EVT_DISCONNECTED:
		LOG_INF("AWS_IOT_EVT_DISCONNECTED");
		aws_on_disconnected();
		break;
	case AWS_IOT_EVT_DATA_RECEIVED:
		LOG_INF("Received AWS message: \"%.*s\" on topic \"%.*s\"", evt->data.msg.len,
			evt->data.msg.ptr, evt->data.msg.topic.len, evt->data.msg.topic.str);
		break;
	case AWS_IOT_EVT_PUBACK:
		LOG_INF("AWS_IOT_EVT_PUBACK, message ID: %d", evt->data.message_id);
		break;
	case AWS_IOT_EVT_PINGRESP:
		break;
	case AWS_IOT_EVT_ERROR:
		LOG_ERR("AWS_IOT_EVT_ERROR: %d", evt->data.err);
		aws_on_disconnected();
		break;
	default:
		break;
	}
}

static mender_err_t mender_network_connect_cb(void)
{
	return MENDER_OK;
}

static mender_err_t mender_network_release_cb(void)
{
	return MENDER_OK;
}

static mender_err_t mender_deployment_status_cb(mender_deployment_status_t status, const char *desc)
{
	LOG_INF("Mender deployment status: %s", desc);
	ARG_UNUSED(status);
	return MENDER_OK;
}

static mender_err_t mender_restart_cb(void)
{
	LOG_WRN("Mender requested reboot; waiting 5s for logs");
	k_sleep(K_SECONDS(5));
	sys_reboot(SYS_REBOOT_COLD);
	return MENDER_OK;
}

static mender_err_t mender_get_identity_cb(const mender_identity_t **identity)
{
	*identity = &mender_identity;
	return MENDER_OK;
}

int main(void)
{
	int err;

	LOG_INF("Starting LTE");

	err = nrf_modem_lib_init();
	if (err < 0) {
		LOG_ERR("Modem init failed: %d", err);
		return err;
	}

	err = lte_lc_connect();
	if (err < 0) {
		LOG_ERR("LTE connect failed: %d", err);
		return err;
	}

	LOG_INF("LTE connected");

	mender_client_config_t mender_config = {
		.recommissioning = false,
		.update_poll_interval = MENDER_POLL_INTERVAL_SECONDS,
	};

	mender_client_callbacks_t mender_callbacks = {
		.network_connect = mender_network_connect_cb,
		.network_release = mender_network_release_cb,
		.deployment_status = mender_deployment_status_cb,
		.restart = mender_restart_cb,
		.get_identity = mender_get_identity_cb,
	};

	if (mender_client_init(&mender_config, &mender_callbacks) != MENDER_OK) {
		LOG_ERR("Mender init failed");
		return -EIO;
	}

#ifdef CONFIG_MENDER_ZEPHYR_IMAGE_UPDATE_MODULE
	if (mender_zephyr_image_register_update_module() != MENDER_OK) {
		LOG_ERR("Mender update module registration failed");
		return err;
	}
#endif

	if (mender_client_activate() != MENDER_OK) {
		LOG_ERR("Mender activate failed");
		return err;
	}

	LOG_INF("Mender activated");
	LOG_INF("Starting AWS");

	err = aws_client_init();
	if (err) {
		LOG_ERR("AWS init failed: %d", err);
		return err;
	}

	(void)k_work_reschedule(&aws_connect_work, K_NO_WAIT);

	while (1) {
		k_sleep(K_SECONDS(10));
	}

	return 0;
}
```
